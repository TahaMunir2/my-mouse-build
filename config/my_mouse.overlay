/ {
    chosen {
        zmk,kscan = &kscan0;
        zmk,pointing-device = &pmw3360;
    };

    kscan0: kscan {
        compatible = "zmk,kscan-gpio-direct";
        label = "KSCAN";
        input-gpios
            = <&gpio0 31 (GPIO_ACTIVE_LOW | GPIO_PULL_UP)>  // D21 Left Click
            , <&gpio0 29 (GPIO_ACTIVE_LOW | GPIO_PULL_UP)>  // D20 Right Click
            , <&gpio1 11 (GPIO_ACTIVE_LOW | GPIO_PULL_UP)>  // D14 Middle Click
            , <&gpio0 2 (GPIO_ACTIVE_LOW | GPIO_PULL_UP)>   // D19 Forward
            , <&gpio1 15 (GPIO_ACTIVE_LOW | GPIO_PULL_UP)>  // D18 Back
            ;
    };
};

&spi0 {
    compatible = "nordic,nrf-spim";
    status = "okay";
    sck-pin = <24>;   // D5, P0.24
    mosi-pin = <20>;  // D3, P0.20
    miso-pin = <22>;  // D4, P0.22
};

pmw3360: pmw3360@0 {
    compatible = "pixart,pmw3360";
    label = "PMW3360";
    status = "okay";
    reg = <0>;
    spi-max-frequency = <2000000>;
    cs-gpios = <&gpio1 0 (GPIO_ACTIVE_LOW)>; // D6, P1.00
    motion-gpios = <&gpio0 11 (GPIO_ACTIVE_HIGH)>; // D7, P0.11
};

&encoder {
    status = "okay";
    a-gpios = <&gpio0 9 (GPIO_PULL_UP)>;   // D10, P0.09
    b-gpios = <&gpio0 10 (GPIO_PULL_UP)>;  // D16, P0.10
};
