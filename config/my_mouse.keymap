#include <behaviors.dtsi>
#include <dt-bindings/zmk/keys.h>
#include <dt-bindings/zmk/mouse.h>

/ {
    keymap {
        compatible = "zmk,keymap";
        default_layer {
            bindings = <
                &mkp LCLK    &mkp RCLK    &mkp MCLK    &mkp FWD     &mkp BACK
            >;
        };
    };
};
